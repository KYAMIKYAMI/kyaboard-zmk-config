/ {
    chosen {
        zmk,keyboard = &kyaboard;
    };
};

&kyaboard {
    compatible = "zmk,keyboard";
    diode-direction = "col2row";

    matrix-row-gpios = <&gpio0 2 GPIO_ACTIVE_LOW>,
                       <&gpio0 3 GPIO_ACTIVE_LOW>,
                       <&gpio0 28 GPIO_ACTIVE_LOW>,
                       <&gpio0 29 GPIO_ACTIVE_LOW>;

    matrix-col-gpios = <&gpio0 4  GPIO_ACTIVE_LOW>,   // col0
                       <&gpio0 5  GPIO_ACTIVE_LOW>,   // col1
                       <&gpio1 11 GPIO_ACTIVE_LOW>,   // col2
                       <&gpio1 12 GPIO_ACTIVE_LOW>,   // col3
                       <&gpio1 13 GPIO_ACTIVE_LOW>,   // col4
                       <&gpio1 14 GPIO_ACTIVE_LOW>,   // col5
                       <&gpio1 15 GPIO_ACTIVE_LOW>;   // col6
};
